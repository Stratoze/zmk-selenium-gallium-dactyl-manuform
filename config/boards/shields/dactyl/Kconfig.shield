## config/boards/shields/dactyl/Kconfig.shield
```kconfig
# No whitespace after the comma or in your part name!
config SHIELD_dactyl_LEFT
    def_bool $(shields_list_contains,dactyl_left)

# No whitespace after the comma or in your part name!
config SHIELD_dactyl_RIGHT
    def_bool $(shields_list_contains,dactyl_right)


CONFIG_ZMK_SOFT_OFF=y
```
